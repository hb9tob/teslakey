## CMakeLists.txt
```
cmake_minimum_required(VERSION 3.20.0)

find_package(Zephyr REQUIRED HINTS $ENV{ZEPHYR_BASE})
project(teslakey)

set(TK_ROOT "${CMAKE_CURRENT_LIST_DIR}/../..")

# Coeur portable : aucun en-tete Zephyr.
target_sources(app PRIVATE
    src/main.c
    ${TK_ROOT}/core/src/tk_pb.c
    ${TK_ROOT}/core/src/tk_digest.c
    ${TK_ROOT}/core/src/tk_meta.c
    ${TK_ROOT}/core/src/tk_session.c
    ${TK_ROOT}/core/src/tk_frame.c
    ${TK_ROOT}/core/src/tk_msg.c
    ${TK_ROOT}/core/src/tk_vcsec.c
    ${TK_ROOT}/core/src/tk_client.c
    ${TK_ROOT}/core/src/tk_err.c
    ${TK_ROOT}/hal/common/tk_crypto_mbedtls.c
    ${TK_ROOT}/hal/nrf/tk_ble_zephyr.c
    ${TK_ROOT}/hal/nrf/tk_platform_nrf.c
)

target_include_directories(app PRIVATE
    ${TK_ROOT}/core/include
    ${TK_ROOT}/core/src
    ${TK_ROOT}/hal/common
    ${TK_ROOT}/hal/nrf
    # secrets/tk_secrets.h (non versionne) fournit le VIN s'il existe.
    ${TK_ROOT}/secrets
)
```

## Kconfig
```
mainmenu "teslakey"

config TESLAKEY_VIN
    string "VIN du vehicule (17 caracteres)"
    default "5YJ3E1EA7JF000000"
    help
      Valeur par defaut fictive : le vrai VIN se met dans
      secrets/tk_secrets.h (ignore par git), qui prend le pas sur cette
      option.

      Le VIN sert a deux choses : deriver le nom BLE recherche
      (SHA1 du VIN) et personnaliser les signatures. Il doit faire
      exactement 17 caracteres.

module = TESLAKEY
module-str = teslakey
source "subsys/logging/Kconfig.template.log_config"

source "Kconfig.zephyr"
```

## prj.conf
```kconfig
# teslakey - nRF52840

# --- Bluetooth : role central uniquement ---
CONFIG_BT=y
CONFIG_BT_CENTRAL=y
CONFIG_BT_OBSERVER=y
CONFIG_BT_PERIPHERAL=n
CONFIG_BT_BROADCASTER=n
CONFIG_BT_GATT_CLIENT=y
CONFIG_BT_MAX_CONN=1

# MTU. Le vehicule reste souvent a 23 : le decoupage en blocs de
# 20 octets est le cas courant, pas une exception.
CONFIG_BT_BUF_ACL_RX_SIZE=251
CONFIG_BT_L2CAP_TX_MTU=247
CONFIG_BT_ATT_PREPARE_COUNT=2

# Pas d'appairage BLE : l'authentification est applicative (ECDH P-256).
CONFIG_BT_SMP=n

CONFIG_BT_DEVICE_NAME="teslakey"

# --- Cryptographie ---
# nrf_security adosse mbedTLS a CryptoCell (CC310) sur nRF52840 :
# P-256 et AES-GCM passent alors par le materiel.
CONFIG_NRF_SECURITY=y
CONFIG_MBEDTLS_ENABLE_HEAP=y
CONFIG_MBEDTLS_HEAP_SIZE=8192

CONFIG_MBEDTLS_ECP_C=y
CONFIG_MBEDTLS_ECDH_C=y
CONFIG_MBEDTLS_ECP_DP_SECP256R1_ENABLED=y
CONFIG_MBEDTLS_GCM_C=y
CONFIG_MBEDTLS_AES_C=y
CONFIG_MBEDTLS_SHA256_C=y
# SHA-1 sert de derivation sur le secret ECDH (PROTOCOL.md section 2).
CONFIG_MBEDTLS_SHA1_C=y

# Alea a usage cryptographique : sys_csrand_get()
CONFIG_ENTROPY_GENERATOR=y
CONFIG_CSPRNG_ENABLED=y

# --- Stockage persistant de la cle privee ---
CONFIG_SETTINGS=y
CONFIG_SETTINGS_NVS=y
CONFIG_NVS=y
CONFIG_FLASH=y
CONFIG_FLASH_MAP=y
CONFIG_FLASH_PAGE_LAYOUT=y

# --- Journal ---
CONFIG_LOG=y
CONFIG_TESLAKEY_LOG_LEVEL_INF=y

# --- Piles ---
# La multiplication scalaire P-256 en logiciel est gourmande en pile.
CONFIG_MAIN_STACK_SIZE=4096
CONFIG_SYSTEM_WORKQUEUE_STACK_SIZE=2048
CONFIG_BT_RX_STACK_SIZE=4096
```

## src/main.c
```c
/*
 * teslakey — application nRF52840 (Zephyr / nRF Connect SDK)
 *
 * Variante porte-cles : un bouton, pas de console indispensable.
 * Le VIN est fourni a la compilation (secrets/tk_secrets.h, a defaut
 * CONFIG_TESLAKEY_VIN), ce qui
 * evite d'avoir a le saisir sur une carte sans console.
 *
 * Bouton (button0 de l'arbre materiel) :
 *   appui court = ouvrir
 *   appui long  = ouvrir et autoriser la conduite
 *   appui tres long (> 3 s) = demander l'appairage
 */
#include <string.h>

#include <zephyr/drivers/gpio.h>
#include <zephyr/kernel.h>
#include <zephyr/logging/log.h>

#include "teslakey/tk_client.h"
#include "teslakey/tk_err.h"

#include "tk_hal_nrf.h"

/* Le vrai VIN vit dans secrets/tk_secrets.h, hors du depot. A defaut on
 * prend le VIN d'exemple de Kconfig. */
#if defined(__has_include)
#if __has_include("tk_secrets.h")
#include "tk_secrets.h"
#endif
#endif
#ifndef TK_SECRET_VIN
#define TK_SECRET_VIN CONFIG_TESLAKEY_VIN
#endif

LOG_MODULE_REGISTER(app, CONFIG_TESLAKEY_LOG_LEVEL);

#define LONG_PRESS_MS       800
#define VERY_LONG_PRESS_MS 3000
#define DEBOUNCE_MS          40

static const struct gpio_dt_spec button =
    GPIO_DT_SPEC_GET_OR(DT_ALIAS(sw0), gpios, { 0 });

/* Statique : le HAL en conserve le pointeur. */
static tk_client s_client;

typedef enum {
    REQ_NONE = 0,
    REQ_UNLOCK,
    REQ_UNLOCK_AND_DRIVE,
    REQ_PAIR,
} request_t;

static volatile request_t s_request;

/* ------------------------------------------------------------------ */
/* Rappels du coeur                                                    */
/* ------------------------------------------------------------------ */

static void on_ready(void *user)
{
    (void)user;
    LOG_INF("session authentifiee");
}

static void on_action_done(void *user, tk_action action, int err)
{
    (void)user;
    if (err == TK_OK) {
        LOG_INF("action %d acceptee", (int)action);
    } else {
        LOG_WRN("action %d refusee : %s", (int)action, tk_strerror(err));
    }
}

static void on_not_whitelisted(void *user)
{
    (void)user;
    LOG_WRN("cle non appairee : maintenir le bouton plus de 3 s, puis "
            "poser la carte NFC sur la console centrale");
}

static void on_error(void *user, int err)
{
    (void)user;
    LOG_WRN("cycle interrompu : %s", tk_strerror(err));
}

/* ------------------------------------------------------------------ */
/* Bouton                                                              */
/* ------------------------------------------------------------------ */

static void button_thread(void *a, void *b, void *c)
{
    (void)a; (void)b; (void)c;

    if (!gpio_is_ready_dt(&button)) {
        LOG_ERR("bouton indisponible : seules les commandes automatiques "
                "fonctionneront");
        return;
    }
    (void)gpio_pin_configure_dt(&button, GPIO_INPUT);

    for (;;) {
        if (gpio_pin_get_dt(&button) == 1) {
            uint32_t held = 0;

            k_msleep(DEBOUNCE_MS);
            if (gpio_pin_get_dt(&button) != 1) {
                continue;   /* rebond */
            }
            while (gpio_pin_get_dt(&button) == 1 && held < 6000) {
                k_msleep(20);
                held += 20;
            }
            if (held >= VERY_LONG_PRESS_MS) {
                s_request = REQ_PAIR;
            } else if (held >= LONG_PRESS_MS) {
                s_request = REQ_UNLOCK_AND_DRIVE;
            } else {
                s_request = REQ_UNLOCK;
            }
            k_msleep(200);
        }
        k_msleep(30);
    }
}

K_THREAD_DEFINE(button_tid, 1024, button_thread, NULL, NULL, NULL,
                7, 0, 0);

/* ------------------------------------------------------------------ */
/* Programme principal                                                 */
/* ------------------------------------------------------------------ */

static void service_request(request_t req)
{
    tk_state st = tk_client_state(&s_client);

    if (req == REQ_PAIR) {
        if (st == TK_STATE_READY || st == TK_STATE_HANDSHAKE ||
            st == TK_STATE_COMMAND) {
            int rc = tk_client_enroll(&s_client, TK_ROLE_DRIVER);
            if (rc == TK_OK) {
                LOG_INF("appairage demande : poser la carte NFC sur la "
                        "console, puis confirmer a l'ecran");
            } else {
                LOG_WRN("appairage impossible : %s", tk_strerror(rc));
            }
        } else {
            LOG_INF("connexion au vehicule avant appairage");
            (void)tk_client_start(&s_client);
        }
        return;
    }

    if (req == REQ_UNLOCK) {
        (void)tk_client_queue(&s_client, TK_ACTION_UNLOCK);
    } else if (req == REQ_UNLOCK_AND_DRIVE) {
        (void)tk_client_unlock_and_drive(&s_client);
    }

    if (st == TK_STATE_IDLE) {
        int rc = tk_client_start(&s_client);
        if (rc != TK_OK) {
            LOG_WRN("demarrage impossible : %s", tk_strerror(rc));
        }
    }
}

int main(void)
{
    tk_hal       hal;
    tk_client_cb cb;
    int          rc;

    LOG_INF("teslakey");

    rc = tk_hal_nrf_init(&hal, &s_client);
    if (rc != TK_OK) {
        LOG_ERR("initialisation du HAL : %s", tk_strerror(rc));
        return 0;
    }

    memset(&cb, 0, sizeof(cb));
    cb.on_ready           = on_ready;
    cb.on_action_done     = on_action_done;
    cb.on_not_whitelisted = on_not_whitelisted;
    cb.on_error           = on_error;

    rc = tk_client_init(&s_client, &hal, &cb, NULL);
    if (rc != TK_OK) {
        LOG_ERR("initialisation du client : %s", tk_strerror(rc));
        return 0;
    }

    rc = tk_hal_nrf_wait_ready(10000);
    if (rc != TK_OK) {
        LOG_ERR("pile Bluetooth indisponible : %s", tk_strerror(rc));
        return 0;
    }

    rc = tk_client_load_or_create_key(&s_client);
    if (rc == 1) {
        LOG_WRN("nouvelle cle generee : un appairage est necessaire");
    } else if (rc < 0) {
        LOG_ERR("cle indisponible : %s", tk_strerror(rc));
        return 0;
    }

    rc = tk_client_set_vin(&s_client, TK_SECRET_VIN);
    if (rc != TK_OK) {
        LOG_ERR("VIN de compilation invalide : il doit faire exactement "
                "17 caracteres");
        return 0;
    }
    {
        char name[TK_LOCAL_NAME_LEN + 1];
        (void)tk_client_local_name(&s_client, name, sizeof(name));
        LOG_INF("nom BLE recherche : %s", name);
    }

    for (;;) {
        request_t req = s_request;

        tk_hal_nrf_lock();
        if (req != REQ_NONE) {
            s_request = REQ_NONE;
            service_request(req);
        }
        tk_client_tick(&s_client);
        tk_hal_nrf_unlock();

        k_msleep(100);
    }
    return 0;
}
```
